## conf/layer.conf
```bitbake
#
# SPDX-License-Identifier: MIT
#

BBPATH .= ":${LAYERDIR}"

BBFILES += "${LAYERDIR}/recipes-*/*/*.bb \
            ${LAYERDIR}/recipes-*/*/*.bbappend"

BBFILE_COLLECTIONS += "meta-hsoc-bsp"
BBFILE_PATTERN_meta-hsoc-bsp = "^${LAYERDIR}/"

LAYERDEPENDS_meta-hsoc-bsp = "core meta-zena-css-bsp meta-zena-css-safety-island"
LAYERSERIES_COMPAT_meta-hsoc-bsp = "walnascar"

HSOC_APOLLO_BASE := "${@os.path.realpath(os.path.join(d.getVar('LAYERDIR'), '..', '..'))}"
HSOC_APOLLO_LINUX_SRC ?= "${HSOC_APOLLO_BASE}/components/primary_compute/linux"
HSOC_APOLLO_UBOOT_SRC ?= "${HSOC_APOLLO_BASE}/components/primary_compute/u-boot"
HSOC_APOLLO_TFA_SRC ?= "${HSOC_APOLLO_BASE}/components/primary_compute/trusted-firmware-a"
HSOC_APOLLO_OPTEE_OS_SRC ?= "${HSOC_APOLLO_BASE}/components/primary_compute/optee_os"
HSOC_APOLLO_TFM_SRC ?= "${HSOC_APOLLO_BASE}/components/system_mgmt/trusted-firmware-m"
HSOC_APOLLO_SCP_FIRMWARE_SRC ?= "${HSOC_APOLLO_BASE}/components/system_mgmt/scp-firmware"
HSOC_APOLLO_ZEPHYRPROJECT_SRC ?= "${HSOC_APOLLO_BASE}/components/system_mgmt/zephyrproject"
HSOC_APOLLO_ZEPHYR_SRC ?= "${HSOC_APOLLO_ZEPHYRPROJECT_SRC}/zephyr"
HSOC_APOLLO_ZEPHYR_HSOC_SRC ?= "${HSOC_APOLLO_ZEPHYRPROJECT_SRC}/zephyr_hsoc_src"
ZENA_CSS_BSP_LAYER ?= "${HSOC_APOLLO_BASE}/../arm-zena-css/yocto/meta-zena-css-bsp"
```

## conf/machine/include/apollo-qvp-cassini-extra-settings.inc
```bitbake
#
# SPDX-License-Identifier: MIT
#

require conf/machine/include/fvp-rd-aspen-cassini-extra-settings.inc
```
